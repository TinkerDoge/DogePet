
#pragma once
#include <Arduino.h>
#include <Adafruit_GFX.h>
#include <pgmspace.h>

// Font: TechTime40
// Source: Technology.ttf, size=40px, glyphs=12
// Generated by tools/font_to_header.py

namespace TechTime40 {

static const uint8_t PROGMEM Bitmaps[] = {
0x3F, 0xFC, 0x1F, 0xF8, 0x4F, 0xF2, 0x60, 0x06, 0x70, 0x0E, 0x70, 0x0E,
0x70, 0x0E, 0x70, 0x0E, 0x70, 0x0E, 0x70, 0x0E, 0x70, 0x0E, 0x60, 0x06,
0x60, 0x06, 0x40, 0x02, 0x00, 0x00, 0x40, 0x02, 0x60, 0x06, 0x70, 0x0E,
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0x00, 0x07, 0x00
};

typedef struct __attribute__((packed)) {
  uint16_t offset;
  uint8_t  w;
  uint8_t  h;
  int8_t   xAdvance;
  int8_t   xOffset;
  int8_t   yOffset;
} Glyph;

static const Glyph PROGMEM Glyphs[] = {
  { 0, 16, 28, 18, 1, -28 },
  { 56, 4, 28, 6, 1, -28 },
  { 84, 16, 28, 18, 1, -28 },
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  { 547, 15, 28, 17, 0, -28 }
};

// UTF-32 codepoints for glyph indices 0..N-1
static const uint32_t PROGMEM Codepoints[] = {
  0x0030,
  0x0031,
  0x0032,
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  0x003A,
  0x003F
};

static const uint8_t  YAdvance = 40;
static const int8_t   Ascent   = 30;
static const int8_t   Descent  = 10;

// Linear search; for bigger sets, generate a binary search.
static int16_t findGlyph(uint32_t cp) {
  uint16_t n = sizeof(Codepoints)/sizeof(Codepoints[0]);
  for (uint16_t i=0;i<n;i++) {
    if (cp == pgm_read_dword(&Codepoints[i])) return (int16_t)i;
  }
  return -1;
}

// Decode next UTF-8 codepoint; returns codepoint, advances index by reference.
static uint32_t decodeUTF8(const char* s, int &i) {
  uint8_t c = (uint8_t)s[i++];
  if (c < 0x80) return c;
  if ((c & 0xE0) == 0xC0) {
    uint32_t c2 = (uint8_t)s[i++];
    return ((c & 0x1F) << 6) | (c2 & 0x3F);
  }
  if ((c & 0xF0) == 0xE0) {
    uint32_t c2 = (uint8_t)s[i++];
    uint32_t c3 = (uint8_t)s[i++];
    return ((c & 0x0F) << 12) | ((c2 & 0x3F) << 6) | (c3 & 0x3F);
  }
  if ((c & 0xF8) == 0xF0) {
    uint32_t c2 = (uint8_t)s[i++];
    uint32_t c3 = (uint8_t)s[i++];
    uint32_t c4 = (uint8_t)s[i++];
    return ((c & 0x07) << 18) | ((c2 & 0x3F) << 12) | ((c3 & 0x3F) << 6) | (c4 & 0x3F);
  }
  return 0x3F; // fallback '?'
}

// Draw a UTF-8 string at baseline (x,y)
static void drawTextUTF8(Adafruit_GFX &d, int16_t x, int16_t y, const char* utf8, uint16_t color=1) {
  for (int i=0; utf8[i];) {
    uint32_t cp = decodeUTF8(utf8, i);
    int16_t gi = findGlyph(cp);
    if (gi < 0) gi = findGlyph(0x3F); // '?'
    uint16_t off = pgm_read_word(&Glyphs[gi].offset);
    uint8_t  gw  = pgm_read_byte(&Glyphs[gi].w);
    uint8_t  gh  = pgm_read_byte(&Glyphs[gi].h);
    int8_t   xa  = pgm_read_byte(&Glyphs[gi].xAdvance);
    int8_t   xo  = pgm_read_byte(&Glyphs[gi].xOffset);
    int8_t   yo  = pgm_read_byte(&Glyphs[gi].yOffset);
    if (gw && gh) {
      d.drawBitmap(x + xo, y + yo, Bitmaps + off, gw, gh, color);
    }
    x += xa;
  }
}

} // namespace TechTime40
