
#pragma once
#include <Arduino.h>
#include <Adafruit_GFX.h>
#include <pgmspace.h>

// Font: VarsityDigits12
// Source: VarsityTeam-Bold.otf, size=12px, glyphs=15
// Generated by tools/font_to_header.py

namespace VarsityDigits12 {

static const uint8_t PROGMEM Bitmaps[] = {
0x00, 0xE8, 0xF8, 0xF8, 0x70, 0x1E, 0x3A, 0x2A, 0x66, 0x00, 0x00, 0x18,
0x10, 0x10, 0x20, 0x20, 0x60, 0x40, 0x40, 0x00, 0x00, 0x7C, 0xFC, 0xCC,
0xCC, 0xCC, 0xCC, 0xFC, 0x78, 0x00, 0xE0, 0x60, 0x60, 0x60, 0x60, 0x60,
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0x0C, 0x3C, 0x38, 0x00, 0x30, 0x30, 0x00
};

typedef struct __attribute__((packed)) {
  uint16_t offset;
  uint8_t  w;
  uint8_t  h;
  int8_t   xAdvance;
  int8_t   xOffset;
  int8_t   yOffset;
} Glyph;

static const Glyph PROGMEM Glyphs[] = {
  { 0, 0, 0, 4, 0, 0 },
  { 0, 8, 10, 8, 0, -9 },
  { 10, 5, 10, 5, 0, -9 },
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  { 117, 6, 10, 6, 0, -9 }
};

// UTF-32 codepoints for glyph indices 0..N-1
static const uint32_t PROGMEM Codepoints[] = {
  0x0020,
  0x0025,
  0x002F,
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  0x003A,
  0x003F
};

static const uint8_t  YAdvance = 13;
static const int8_t   Ascent   = 11;
static const int8_t   Descent  = 3;

// Linear search; for bigger sets, generate a binary search.
static int16_t findGlyph(uint32_t cp) {
  uint16_t n = sizeof(Codepoints)/sizeof(Codepoints[0]);
  for (uint16_t i=0;i<n;i++) {
    if (cp == pgm_read_dword(&Codepoints[i])) return (int16_t)i;
  }
  return -1;
}

// Decode next UTF-8 codepoint; returns codepoint, advances index by reference.
static uint32_t decodeUTF8(const char* s, int &i) {
  uint8_t c = (uint8_t)s[i++];
  if (c < 0x80) return c;
  if ((c & 0xE0) == 0xC0) {
    uint32_t c2 = (uint8_t)s[i++];
    return ((c & 0x1F) << 6) | (c2 & 0x3F);
  }
  if ((c & 0xF0) == 0xE0) {
    uint32_t c2 = (uint8_t)s[i++];
    uint32_t c3 = (uint8_t)s[i++];
    return ((c & 0x0F) << 12) | ((c2 & 0x3F) << 6) | (c3 & 0x3F);
  }
  if ((c & 0xF8) == 0xF0) {
    uint32_t c2 = (uint8_t)s[i++];
    uint32_t c3 = (uint8_t)s[i++];
    uint32_t c4 = (uint8_t)s[i++];
    return ((c & 0x07) << 18) | ((c2 & 0x3F) << 12) | ((c3 & 0x3F) << 6) | (c4 & 0x3F);
  }
  return 0x3F; // fallback '?'
}

// Draw a UTF-8 string at baseline (x,y)
static void drawTextUTF8(Adafruit_GFX &d, int16_t x, int16_t y, const char* utf8, uint16_t color=1) {
  for (int i=0; utf8[i];) {
    uint32_t cp = decodeUTF8(utf8, i);
    int16_t gi = findGlyph(cp);
    if (gi < 0) gi = findGlyph(0x3F); // '?'
    uint16_t off = pgm_read_word(&Glyphs[gi].offset);
    uint8_t  gw  = pgm_read_byte(&Glyphs[gi].w);
    uint8_t  gh  = pgm_read_byte(&Glyphs[gi].h);
    int8_t   xa  = pgm_read_byte(&Glyphs[gi].xAdvance);
    int8_t   xo  = pgm_read_byte(&Glyphs[gi].xOffset);
    int8_t   yo  = pgm_read_byte(&Glyphs[gi].yOffset);
    if (gw && gh) {
      d.drawBitmap(x + xo, y + yo, Bitmaps + off, gw, gh, color);
    }
    x += xa;
  }
}

} // namespace VarsityDigits12
